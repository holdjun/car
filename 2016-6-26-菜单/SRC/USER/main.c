#include "sys.h"
#include "gpio.h"
#include "delay.h"
#include "led.h"
#include "uart.h"
#include "wdog.h"
#include "pit.h"
#include "rtc.h"
#include "dma.h"
#include "ftm.h"
#include "lptm.h"
#include "adc.h"
#include "dac.h"
#include "tsi.h"
#include "spi.h"
#include "enet.h"
#include "i2c.h"
#include "pdb.h"
#include "can.h"
#include "sd.h"
#include "flash.h"
#include "spiflash.h"
#include "spilcd.h"
#include "stdio.h"
#include "mma845x.h"
#include "oled.h"
unsigned char j=0,k,flag;
unsigned char hanzi[8]={12,13,7,7,7,7,7,7};
const unsigned char china[768] = { /* 0X22,0X01,0X60,0X00,0X40,0X00, */
0XFF,0XFF,0XFF,0XFF,0XFF,0XFF,0XFF,0XFF,0XFF,0XFF,0XFF,0XFF,0XFF,0XFF,0XFF,0XFF,
0XFF,0XFF,0XFF,0XFF,0XFF,0XFF,0XFF,0XFF,0XFF,0XFF,0XFF,0XFF,0XFF,0XFF,0X5F,0X1F,
0X1F,0XBF,0XBF,0XFF,0XFF,0XFF,0XFF,0XFF,0XFF,0XFF,0XFF,0XFF,0XFF,0XFF,0XFF,0XFF,
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0XFF,0XFF,0XFF,0XFF,0XFF,0XFF,0XFF,0XFF,0XFF,0XFF,0XFF,0XFF,0XFF,0XFF,0XFF,0XFF,
};
const unsigned char gelujiya[768] = { /* 0X22,0X01,0X60,0X00,0X40,0X00, */
0X00,0X00,0X00,0X00,0X00,0X00,0X00,0X00,0X00,0X00,0X00,0X00,0X00,0X00,0X00,0X00,
0X00,0X00,0X00,0XC0,0XC0,0XC0,0XC0,0X00,0X00,0X00,0X00,0X00,0X00,0X00,0X00,0X00,
0X00,0X00,0X00,0X00,0X00,0X00,0X00,0X00,0X00,0X00,0XFF,0XFF,0XFF,0XFF,0XFF,0XFF,
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0X00,0X00,0X00,0X00,0X00,0X00,0X00,0X00,0X00,0X00,0X00,0X00,0X00,0X00,0X00,0X00,
};

const unsigned char yiselie[704] = { /* 0X22,0X01,0X58,0X00,0X40,0X00, */
0XC1,0XC0,0XC0,0XC0,0XC0,0XC0,0XC0,0XC3,0XC0,0XC0,0XC0,0XC0,0XC0,0XC0,0XC0,0XC0,
0XC0,0XC0,0XC0,0XC0,0XC0,0XC0,0XC0,0XC0,0XC0,0XC0,0XC0,0XC0,0XC0,0XC0,0XC0,0XC0,
0XC0,0XC0,0XC0,0XC0,0XC0,0XC0,0XC0,0XC0,0XC0,0XC0,0XC0,0XC0,0XC0,0XC0,0XC0,0XC0,
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0X03,0X03,0X03,0X03,0X03,0X03,0X03,0X03,0X03,0X03,0X03,0X83,0X83,0X03,0X83,0XFB,
};




const unsigned char banama[752] = { /* 0X22,0X01,0X5E,0X00,0X40,0X00, */
0X00,0X00,0X00,0X00,0X00,0X00,0X00,0X00,0X00,0X00,0X00,0X00,0X00,0X00,0X00,0X00,
0X00,0X00,0X00,0X00,0X00,0X00,0X00,0XC0,0X00,0X00,0X00,0X00,0X00,0X00,0X00,0X00,
0X00,0X00,0X00,0X00,0X00,0X00,0X00,0X00,0X00,0X00,0X00,0X00,0X00,0X00,0X00,0XFF,
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0X00,0X00,0X00,0X00,0X00,0X00,0X00,0X00,0X00,0X00,0X00,0X00,0X00,0X00,0X00,0X00,
};


const unsigned char fenlan[816] = { /* 0X22,0X01,0X66,0X00,0X40,0X00, */
0X00,0X00,0X00,0X00,0X00,0X00,0X00,0X00,0X00,0X00,0X00,0X00,0X00,0X00,0X00,0X00,
0X00,0X00,0X00,0X00,0X00,0X00,0X00,0X00,0X00,0X00,0X00,0X00,0XFF,0XFF,0XFF,0XFF,
0XFF,0XFF,0XFF,0XFF,0XFF,0XFF,0XFF,0XFF,0XFF,0XFF,0XFF,0XFF,0XFF,0X00,0X00,0X00,
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0X00,0X00,0X00,0X00,0X00,0X00,0X00,0X00,0X00,0X00,0X00,0X00,0X00,0X00,0X00,0X80,
};

unsigned char we(unsigned char x,unsigned char i){
	if(i>6){ 
	if(	x<=i-6){
			return 9;
	 }
	 else
			return x-i+6;
}
	else
		return x;
}
int main(void)
{
	unsigned char i=2;
	GPIO_InitTypeDef GPIO_InitStruct1;
	PIT_InitTypeDef PIT_InitStruct1;
	SystemClockSetup(ClockSource_EX50M,CoreClock_100M);
	DelayInit();
	GPIO_InitStruct1.GPIOx = PTA;                             
	GPIO_InitStruct1.GPIO_InitState = Bit_SET;                
	GPIO_InitStruct1.GPIO_IRQMode = GPIO_IT_DISABLE;          
	GPIO_InitStruct1.GPIO_Pin = GPIO_Pin_27;  	
	GPIO_InitStruct1.GPIO_Mode = GPIO_Mode_IPU;               
	GPIO_Init(&GPIO_InitStruct1);  
	GPIO_InitStruct1.GPIOx = PTA;                             
	GPIO_InitStruct1.GPIO_InitState = Bit_SET;                
	GPIO_InitStruct1.GPIO_IRQMode = GPIO_IT_DISABLE;          
	GPIO_InitStruct1.GPIO_Pin = GPIO_Pin_26;  	
	GPIO_InitStruct1.GPIO_Mode = GPIO_Mode_IPU;               
	GPIO_Init(&GPIO_InitStruct1); 
	GPIO_InitStruct1.GPIOx = PTA;                             
	GPIO_InitStruct1.GPIO_InitState = Bit_SET;                
	GPIO_InitStruct1.GPIO_IRQMode = GPIO_IT_DISABLE;          
	GPIO_InitStruct1.GPIO_Pin = GPIO_Pin_25;  	
	GPIO_InitStruct1.GPIO_Mode = GPIO_Mode_IPU;               
	GPIO_Init(&GPIO_InitStruct1);
	GPIO_InitStruct1.GPIOx = PTA;                             
	GPIO_InitStruct1.GPIO_InitState = Bit_SET;                
	GPIO_InitStruct1.GPIO_IRQMode = GPIO_IT_DISABLE;          
	GPIO_InitStruct1.GPIO_Pin = GPIO_Pin_28;  	
	GPIO_InitStruct1.GPIO_Mode = GPIO_Mode_IPU;               
	GPIO_Init(&GPIO_InitStruct1);
	PIT_InitStruct1.PITx=PIT0; 
	PIT_InitStruct1.PIT_Interval=200; 
	PIT_Init(&PIT_InitStruct1);
	PIT_ITConfig(PIT0,PIT_IT_TIF,ENABLE); 
	NVIC_EnableIRQ(PIT0_IRQn);
	OLED_Init();

	while(1)
	{
		OLED_Write_Chinese(1,we(2,i),14);
		OLED_Write_Chinese(2,we(2,i),12);
		OLED_Write_Chinese(3,we(2,i),7);
		OLED_Write_Chinese(4,we(2,i),7);
		
		OLED_Write_Chinese(1,we(4,i),15);
		OLED_Write_Chinese(2,we(4,i),16);
		OLED_Write_Chinese(3,we(4,i),17);
		OLED_Write_Chinese(4,we(4,i),7);
		
		OLED_Write_Chinese(1,we(6,i),18);
		OLED_Write_Chinese(2,we(6,i),19);
		OLED_Write_Chinese(3,we(6,i),20);
		OLED_Write_Chinese(4,we(6,i),21);		
		
		OLED_Write_Chinese(1,we(8,i),22);
		OLED_Write_Chinese(2,we(8,i),23);
		OLED_Write_Chinese(3,we(8,i),24);
		OLED_Write_Chinese(4,we(8,i),7);
		
		OLED_Write_Chinese(1,we(10,i),25);
		OLED_Write_Chinese(2,we(10,i),26);
		OLED_Write_Chinese(3,we(10,i),7);
		OLED_Write_Chinese(4,we(10,i),7);
		/*if(i<8){
		OLED_Write_Chinese(1,2,0);
		OLED_Write_Chinese(2,2,1);
		OLED_Write_Chinese(3,2,3);
		OLED_Write_Chinese(4,2,4);
		OLED_Write_Chinese(1,4,2);
		OLED_Write_Chinese(2,4,1);
		OLED_Write_Chinese(3,4,3);
		OLED_Write_Chinese(4,4,4);
		OLED_Write_Chinese(1,6,5);
		OLED_Write_Chinese(2,6,6);
		OLED_Write_Chinese(3,6,3);
		OLED_Write_Chinese(4,6,4);
		}
		if(i==8){
		OLED_Write_Chinese(1,2,2);
		OLED_Write_Chinese(2,2,1);
		OLED_Write_Chinese(3,2,3);
		OLED_Write_Chinese(4,2,4);
		OLED_Write_Chinese(1,4,5);
		OLED_Write_Chinese(2,4,6);
		OLED_Write_Chinese(3,4,3);
		OLED_Write_Chinese(4,4,4);
		OLED_Write_Chinese(1,6,8);
		OLED_Write_Chinese(2,6,9);
		
		}
		if(i==10){
		OLED_Write_Chinese(1,2,5);
		OLED_Write_Chinese(2,2,6);
		OLED_Write_Chinese(3,2,3);
		OLED_Write_Chinese(4,2,4);
		OLED_Write_Chinese(1,4,8);
		OLED_Write_Chinese(2,4,9);
		OLED_Write_Chinese(1,6,10);
		OLED_Write_Chinese(2,6,11);
		}		*/
		for(k=0;k<8;k++){
			OLED_Write_Chinese(k,0,hanzi[(j+k)%8]);
		}
		/*OLED_Write_Chinese((j+0)%8,0,3);
		OLED_Write_Chinese((j+1)%8,0,4);	
    OLED_Write_Chinese((j+2)%8,0,7);	
		OLED_Write_Chinese((j+3)%8,0,7);
		OLED_Write_Chinese((j+4)%8,0,7);	
		OLED_Write_Chinese((j+5)%8,0,7);
		OLED_Write_Chinese((j+6)%8,0,7);	
		OLED_Write_Chinese((j+7)%8,0,7);*/
		OLED_Write_Char(0,we(i,i),43);
		
		if(GPIO_ReadInputDataBit(PTA,GPIO_Pin_27)==0){
		DelayMs(50);
			if(GPIO_ReadInputDataBit(PTA,GPIO_Pin_27)==0){
				OLED_Write_Char(0,i,' ');
				i+=2;
				if(i==12)
					i=2;
				while(!GPIO_ReadInputDataBit(PTA,GPIO_Pin_27));
				
			}
		}
		if(GPIO_ReadInputDataBit(PTA,GPIO_Pin_26)==0){
		DelayMs(50);
			if(GPIO_ReadInputDataBit(PTA,GPIO_Pin_26)==0){
				OLED_Write_Char(0,i,' ');
				i-=2;
				if(i==0)
					i=10;
				while(!GPIO_ReadInputDataBit(PTA,GPIO_Pin_26));
				
			}
		}
		if(GPIO_ReadInputDataBit(PTA,GPIO_Pin_25)==0){
		DelayMs(50);
			if(GPIO_ReadInputDataBit(PTA,GPIO_Pin_25)==0){
				flag=1;
				OLED_Clear();
				while(!GPIO_ReadInputDataBit(PTA,GPIO_Pin_25));
				
			}
		}
		while(flag){
			if(i==2){
				OLED_Write_Picture(64,96,china);
			}
			if(i==4){
				OLED_Write_Picture(64,94,banama);
			}
			if(i==6){
				OLED_Write_Picture(64,96,gelujiya);
			}
			if(i==8){
				OLED_Write_Picture(64,88,yiselie);
			}
			if(i==10){
				OLED_Write_Picture(64,102,fenlan);
			}
		if(GPIO_ReadInputDataBit(PTA,GPIO_Pin_28)==0){
		DelayMs(50);
			if(GPIO_ReadInputDataBit(PTA,GPIO_Pin_28)==0){
				flag=0;
				OLED_Clear();
				while(!GPIO_ReadInputDataBit(PTA,GPIO_Pin_28));
				
			}
		}
			
		}
		
		
	}
}


void assert_failed(uint8_t* file, uint32_t line)
{
	UART_printf("assert_failed:line:%d %s\r\n",line,file);
	while(1);
}


